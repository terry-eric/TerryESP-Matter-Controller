## firmware/matter_ws2812/main/Kconfig.projbuild
```kconfig
menu "WS2812 Matter light"

config WS2812_GPIO
    int "WS2812 data GPIO"
    default 10
    range 0 21
    help
        GPIO connected to the DIN input of the WS2812 strip.

config WS2812_NUM_LEDS
    int "Number of WS2812 LEDs"
    default 256
    range 1 1024
    help
        Number of addressable pixels in the strip.

config WS2812_MAX_BRIGHTNESS
    int "Maximum strip brightness percent"
    default 60
    range 1 100
    help
        Safety cap for the strip output. Verify the strip power supply before
        increasing this value, especially when using many pixels at white.

endmenu
```

## firmware/matter_ws2812/sdkconfig.defaults
```kconfig
CONFIG_ESPTOOLPY_FLASHSIZE_4MB=y
CONFIG_PARTITION_TABLE_CUSTOM=y
CONFIG_PARTITION_TABLE_FILENAME="partitions.csv"
CONFIG_PARTITION_TABLE_OFFSET=0x8000
CONFIG_BT_ENABLED=y
CONFIG_BT_NIMBLE_ENABLED=y
CONFIG_BT_NIMBLE_ENABLE_CONN_REATTEMPT=n
CONFIG_ESP_PROTOCOMM_SUPPORT_SECURITY_VERSION_1=y
CONFIG_LWIP_IPV6_AUTOCONFIG=y
CONFIG_LWIP_HOOK_IP6_ROUTE_DEFAULT=y
CONFIG_LWIP_HOOK_ND6_GET_GW_DEFAULT=y
CONFIG_LWIP_IPV6_NUM_ADDRESSES=6
CONFIG_ENABLE_WIFI_AP=n
CONFIG_ESP_WIFI_SOFTAP_SUPPORT=n
CONFIG_ENABLE_OTA_REQUESTOR=y
CONFIG_MBEDTLS_HKDF_C=y
CONFIG_WS2812_MAX_BRIGHTNESS=60
CONFIG_ESP_MATTER_MAX_DYNAMIC_ENDPOINT_COUNT=2
```
